#include <SPI.h>
#include <Wire.h>
#include <Adafruit_GFX.h>
#include <Adafruit_SSD1331.h>


const int SWA_pin = 5;

#define PlayerLeft A1
#define PlayerRight A3

// Color definitions
#define BLACK           0x0000
#define BLUE            0x001F
#define RED             0xF800
#define GREEN           0x07E0
#define CYAN            0x07FF
#define MAGENTA         0xF81F
#define YELLOW          0xFFE0  
#define WHITE           0xFFFF

//Lower is faster for the rates
const unsigned long PADDLE_RATE = 33;
const unsigned long BALL_RATE = 30;
const uint8_t PADDLE_HEIGHT = 16;
int MAX_SCORE = 8;

int PL_SCORE = 0;
int PR_SCORE = 0;


// You can use any (4 or) 5 pins 
#define sclk 13
#define mosi 11
#define cs   10
#define rst  9
#define dc   8

// MOSI is Data pin on display breakout
Adafruit_SSD1331 display = Adafruit_SSD1331(cs, dc, rst);


void drawCourt();

uint8_t ball_x = 64, ball_y = 32;
uint8_t ball_dir_x = 1, ball_dir_y = 1;

boolean gameIsRunning = true;
boolean resetBall = false;

const unsigned char myBitmap [] PROGMEM = {
  // 'PONGYOURSELF, 96x64px
  0x00, 0x00, 0x00, 0x00, 0x00, 0x00, 0x00, 0x00, 0x00, 0x00, 0x00, 0x00, 0x00, 0x00, 0x00, 0x00, 
  0x00, 0x00, 0x00, 0x00, 0x00, 0x00, 0x00, 0x00, 0x00, 0x00, 0x00, 0x00, 0x00, 0x00, 0x00, 0x00, 
  0x00, 0x00, 0x00, 0x00, 0x00, 0x00, 0x00, 0x00, 0x00, 0x00, 0x00, 0x00, 0x00, 0x00, 0x00, 0x00, 
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  0x00, 0x00, 0x00, 0x00, 0x00, 0x00, 0x00, 0x00, 0x00, 0x00, 0x00, 0x00, 0x00, 0x00, 0x00, 0x00
};

unsigned long ball_update;
unsigned long paddle_update;

//PlayerLeft paddle
const uint8_t PL_X = 12;
uint8_t PL_Y = 16;

//PlayerRight paddle
const uint8_t PR_X = 85;
uint8_t PR_Y = 16;

void setup() {
    pinMode(SWA_pin, INPUT);
    titleScreen();
}

void loop() {

    unsigned long time = millis();    

    if(resetBall){
      ball_x = random(32,64); //Middle third of board
      ball_y = random(3,63); //Between top and bottom on screen
      do{
      ball_dir_x = random(-1,2);
      }while(ball_dir_x==0);

       do{
      ball_dir_y = random(-1,2);
      }while(ball_dir_y==0);
      
      resetBall=false;
    }

    if(time > ball_update && gameIsRunning) {
        uint8_t new_x = ball_x + ball_dir_x;
        uint8_t new_y = ball_y + ball_dir_y;

        // Check if we hit the left wall
        if(new_x == 0){ //PlayerRight Gets a Point
            PR_SCORE++;
            if(PR_SCORE==MAX_SCORE){
              gameOver();
            }else{
              showScore();
            }
        }

         // Check if we hit the right wall
        if(new_x == 95){ //PlayerLeft Gets a Point
            PL_SCORE++;
            if(PL_SCORE==MAX_SCORE){
              gameOver();
            }else{
              showScore();
            }
        }

        // Check if we hit the top or bottom.
        if(new_y == 0 || new_y == 63) {
            ball_dir_y = -ball_dir_y;
            new_y += ball_dir_y + ball_dir_y;
        }

        // Check if we hit the PlayerLeft paddle
        if(new_x == PL_X && new_y >= PL_Y && new_y <= PL_Y + PADDLE_HEIGHT) {
            ball_dir_x = -ball_dir_x;
            new_x += ball_dir_x + ball_dir_x;
        }

        // Check if we hit the PlayerRight paddle
        if(new_x == PR_X && new_y >= PR_Y && new_y <= PR_Y + PADDLE_HEIGHT){
            ball_dir_x = -ball_dir_x;
            new_x += ball_dir_x + ball_dir_x;
        }

        display.drawPixel(ball_x, ball_y, BLACK);
        display.drawPixel(new_x, new_y, WHITE);
        ball_x = new_x;
        ball_y = new_y;

        ball_update += BALL_RATE;

    }

    if(time > paddle_update && gameIsRunning) {
        paddle_update += PADDLE_RATE;

        // PlayerLeft 
        display.drawFastVLine(PL_X, PL_Y,PADDLE_HEIGHT, BLACK);
        if(analogRead(PlayerLeft) < 500) {
            PL_Y += 1;
        }
        if(analogRead(PlayerLeft) > 520) {
            PL_Y -= 1;
        }
        if(PL_Y < 1) PL_Y = 1;
        if(PL_Y + PADDLE_HEIGHT > 63) PL_Y = 63 - PADDLE_HEIGHT;
        display.drawFastVLine(PL_X, PL_Y, PADDLE_HEIGHT, CYAN);

        // PlayerRight
        //Down is under 511
        display.drawFastVLine(PR_X, PR_Y,PADDLE_HEIGHT, BLACK);
        if(analogRead(PlayerRight) < 500) {
            PR_Y += 1;
        }
        if(analogRead(PlayerRight) > 520) {
            PR_Y -= 1;
        }
        if(PR_Y < 1) PR_Y = 1;
        if(PR_Y + PADDLE_HEIGHT > 63) PR_Y = 63 - PADDLE_HEIGHT;
        display.drawFastVLine(PR_X, PR_Y, PADDLE_HEIGHT, GREEN);
    }
}

void drawCourt() {
    display.drawRect(0, 0, 96, 64, WHITE);
}

void gameOver(){
  gameIsRunning = false;
  display.fillScreen(BLACK);
  drawCourt();
  if(PR_SCORE>PL_SCORE){
    display.setCursor(5,4);
    display.setTextColor(WHITE);
    display.setTextSize(2);
    display.print("PR Won");
  }else{
    display.setCursor(5,4);
    display.setTextColor(WHITE);
    display.setTextSize(2);
    display.print("PL Won");
  }

  display.setCursor(20,30);
  display.setTextColor(CYAN);
  display.setTextSize(3);
  display.print(String(PL_SCORE));

  display.setCursor(60,30);
  display.setTextColor(GREEN);
  display.setTextSize(3);
  display.print(String(PR_SCORE));
  
  delay(2000);

  while(digitalRead(SWA_pin) == HIGH)  
  {
    delay(100);
  }
  titleScreen();
  gameIsRunning = true;
  
  PL_SCORE = PR_SCORE = 0;
  
  unsigned long start = millis();
  display.fillScreen(BLACK);
  drawCourt();
  while(millis() - start < 2000);
  ball_update = millis();    
  paddle_update = ball_update;
  gameIsRunning = true;
  resetBall=true;
}

void showScore(){
  gameIsRunning = false;
  display.fillScreen(BLACK);
  drawCourt();
  
  display.setCursor(15,4);
  display.setTextColor(WHITE);
  display.setTextSize(2);
  display.print("Score");

  display.setCursor(20,30);
  display.setTextColor(CYAN);
  display.setTextSize(3);
  display.print(String(PL_SCORE));

  display.setCursor(60,30);
  display.setTextColor(GREEN);
  display.setTextSize(3);
  display.print(String(PR_SCORE));

 delay(2000);
 unsigned long start = millis();

 display.fillScreen(BLACK);
 drawCourt();
 while(millis() - start < 2000);
 ball_update = millis();    
 paddle_update = ball_update;
 gameIsRunning = true;
 resetBall=true;
}

void titleScreen(){
    display.begin();
    display.fillScreen(BLACK);
    display.drawBitmap(0, 0, myBitmap, 96, 64, CYAN);
    digitalWrite(SWA_pin, HIGH);
    //Basically 'Press Start' to continue
    //but start is SWA
    while(digitalRead(SWA_pin) == HIGH)  
  {
    delay(100);
  }
    unsigned long start = millis();
    display.fillScreen(BLACK);
    drawCourt();

    while(millis() - start < 2000);
    ball_update = millis();
    paddle_update = ball_update;
    ball_x = random(25,65); 
    ball_y = random(3,63);
}
